## main/Kconfig.projbuild
```kconfig
menu "ESP Lightning MQTT"

    menu "Wi-Fi"
        config WIFI_SSID
            string "Wi-Fi SSID"
            default "myssid"
            help
                SSID of the Wi-Fi network to connect to.

        config WIFI_PASSWORD
            string "Wi-Fi Password"
            default "mypassword"
            help
                Password for the Wi-Fi network.
    endmenu

    menu "MQTT Broker"
        config MQTT_BROKER_URL
            string "MQTT Broker URL"
            default "mqtt://192.168.1.10:1883"
            help
                URL of the MQTT broker (e.g. mqtt://192.168.1.10:1883).

        config MQTT_USERNAME
            string "MQTT Username"
            default ""
            help
                Username for MQTT authentication (leave empty if not required).

        config MQTT_PASSWORD
            string "MQTT Password"
            default ""
            help
                Password for MQTT authentication (leave empty if not required).

        config MQTT_BASE_TOPIC
            string "MQTT Base Topic"
            default "esp-lightning-mqtt"
            help
                Base topic prefix. Full topic: <base>/<device_id>/<subtopic>.
    endmenu

    menu "AS3935 Sensor"
        config AS3935_I2C_ADDR
            hex "AS3935 I2C Address"
            default 0x03
            range 0x01 0x07
            help
                AS3935 I2C address. Default 0x03 (ADD pins to GND).

        config AS3935_I2C_PORT
            int "I2C Port Number"
            default 0
            range 0 1
            help
                ESP32-C3 I2C port number (0 or 1).

        config AS3935_SDA_GPIO
            int "I2C SDA GPIO"
            default 6
            help
                GPIO number for I2C SDA line. Requires 4.7 kΩ pull-up to 3.3 V.

        config AS3935_SCL_GPIO
            int "I2C SCL GPIO"
            default 7
            help
                GPIO number for I2C SCL line. Requires 4.7 kΩ pull-up to 3.3 V.

        config AS3935_IRQ_GPIO
            int "AS3935 IRQ GPIO"
            default 4
            help
                GPIO number for AS3935 interrupt line (active-high).

        config AS3935_INDOOR_MODE
            bool "Indoor Mode"
            default y
            help
                Enable indoor mode (higher noise floor tolerance).
                Disable for outdoor deployment.
    endmenu

endmenu
```

## sdkconfig.defaults
```kconfig
# Production defaults for esp-lightning-mqtt
# Generated for ESP32-C3 / ESP-IDF v5.x

# Logging: INFO level in production
CONFIG_LOG_DEFAULT_LEVEL_INFO=y
CONFIG_LOG_DEFAULT_LEVEL=3

# Optimise for size
CONFIG_COMPILER_OPTIMIZATION_SIZE=y

# PSRAM: not present on bare ESP32-C3
CONFIG_SPIRAM=n

# FreeRTOS tick rate
CONFIG_FREERTOS_HZ=1000

# MQTT component
CONFIG_MQTT_PROTOCOL_311=y
CONFIG_MQTT_TRANSPORT_TCP=y

# NVS
CONFIG_NVS_ENCRYPTION=n

# Wi-Fi
CONFIG_ESP_WIFI_STATIC_RX_BUFFER_NUM=4
CONFIG_ESP_WIFI_DYNAMIC_RX_BUFFER_NUM=8

# --- Project settings (override via idf.py menuconfig) ---
CONFIG_WIFI_SSID="myssid"
CONFIG_WIFI_PASSWORD="mypassword"
CONFIG_MQTT_BROKER_URL="mqtt://192.168.1.10:1883"
CONFIG_MQTT_USERNAME=""
CONFIG_MQTT_PASSWORD=""
CONFIG_MQTT_BASE_TOPIC="esp-lightning-mqtt"
CONFIG_AS3935_I2C_ADDR=0x03
CONFIG_AS3935_I2C_PORT=0
CONFIG_AS3935_SDA_GPIO=6
CONFIG_AS3935_SCL_GPIO=7
CONFIG_AS3935_IRQ_GPIO=4
CONFIG_AS3935_INDOOR_MODE=y
```
